## meta-fe/conf/layer.conf
```bitbake
# We have a conf and classes directory, add to BBPATH
BBPATH .= ":${LAYERDIR}"

# We have recipes-* directories, add to BBFILES
BBFILES += "${LAYERDIR}/recipes-*/*/*.bb \
            ${LAYERDIR}/recipes-*/*/*.bbappend"

BBFILE_COLLECTIONS += "meta-fe"
BBFILE_PATTERN_meta-fe = "^${LAYERDIR}/"
BBFILE_PRIORITY_meta-fe = "6"

LAYERDEPENDS_meta-fe = "core"
LAYERSERIES_COMPAT_meta-fe = "styhead walnascar"
```
